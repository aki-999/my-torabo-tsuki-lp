## boards/shields/torabo_tsuki_lp/Kconfig.shield
```kconfig
config SHIELD_TORABO_TSUKI_LP_LEFT
    def_bool $(shields_list_contains,torabo_tsuki_lp_left)

config SHIELD_TORABO_TSUKI_LP_RIGHT
    def_bool $(shields_list_contains,torabo_tsuki_lp_right)
```
