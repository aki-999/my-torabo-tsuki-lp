#include "torabo_tsuki_lp.dtsi"
#include <input/processors.dtsi>
#include <dt-bindings/zmk/input_transform.h>

&trackball_listener {
    input-processors = <&zip_temp_layer 4 10000>;
};

&size_s_transform {
    col-offset = <7>;
};

// &size_m_transform {
//     col-offset = <7>;
// };

&size_l_transform {
    col-offset = <7>;
};